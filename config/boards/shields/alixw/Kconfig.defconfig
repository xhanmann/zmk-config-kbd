## config/boards/shields/alixw/Kconfig.defconfig
```kconfig
if SHIELD_ALIXW

config ZMK_KEYBOARD_NAME
    default "alixw"

endif

if ZMK_DISPLAY

config I2C
	default y

config SSD1306
	default y

config SSD1306_REVERSE_MODE
	default n

endif # ZMK_DISPLAY
```

## config/boards/shields/xbowsw/Kconfig.defconfig
```kconfig
if SHIELD_XBOWSW

config ZMK_KEYBOARD_NAME
    default "xbowsw"

endif

if ZMK_DISPLAY

config I2C
	default y

config SSD1306
	default y

config SSD1306_REVERSE_MODE
	default y

endif # ZMK_DISPLAY
```
